## dht11_sensor_mqtt/esp32_s2/main/Kconfig.projbuild
```kconfig
menu "WiFi Configuration"

config WIFI_SSID
    string "WiFi SSID"
    default "WIFI_NAME"
    help
        Name of the WiFi the ESP32-S2 should connect to.

config WIFI_PASSWORD
    string "WiFi Password"
    default "PASSWORD"
    help
        WiFi's password.

endmenu

menu "UART Configuration"

    orsource "$IDF_PATH/examples/common_components/env_caps/$IDF_TARGET/Kconfig.env_caps"

    config UART_BAUD_RATE
        int "UART communication speed"
        range 1200 115200
        default 115200
        help
            UART communication speed.

    config UART_RXD
        int "UART RXD pin number"
        range ENV_GPIO_RANGE_MIN ENV_GPIO_IN_RANGE_MAX
        default 5 if !IDF_TARGET_ESP32H4
        default 15 if IDF_TARGET_ESP32H4
        help
            GPIO number for UART RX pin. See UART documentation for more information
            about available pin numbers for UART.

    config UART_TXD
        int "UART TXD pin number"
        range ENV_GPIO_RANGE_MIN ENV_GPIO_OUT_RANGE_MAX
        default 4 if !IDF_TARGET_ESP32H4
        default 16 if IDF_TARGET_ESP32H4
        help
            GPIO number for UART TX pin. See UART documentation for more information
            about available pin numbers for UART.

    config TASK_STACK_SIZE
        int "Task stack size"
        range 1024 16384
        default 3072
        help
            Defines stack size for UART TX and RX tasks. Insufficient stack size can cause crash.

endmenu
```
